// =============================================================================
// SHARED CONSTANTS FOR ALL BEHAVIORS
// =============================================================================


// layer defenitions
#define QWERTY              0
#define QWERTYWithRpdLower  1
#define LowerForOsRpd       2
#define GamingQWERTY        3
#define RightSideQWERTY     4
#define RPD                 5
#define GamingRPD           6
#define LOWER               7
#define RAISE               8
#define LowerLower          9
#define RaiseRaise          10


// Default timing constants for hold-tap behaviors
#define DEFAULT_TAPPING_TERM 300
#define DEFAULT_QUICK_TAP 170
#define DEFAULT_PRIOR_IDLE 150

#define HRM_PRIOR_IDLE_SFT 100

// Key position groups using semantic labels
#include "zmk-helpers/key-labels/lily58.h"

#define KEYS_L LT5 LT4 LT3 LT2 LT1 LT0   LM5 LM4 LM3 LM2 LM1 LM0   LB5 LB4 LB3 LB2 LB1 LB0   LF5 LF4 LF3 LF2 LF1 LF0
#define KEYS_R RT0 RT1 RT2 RT3 RT4 RT5   RM0 RM1 RM2 RM3 RM4 RM5   RB0 RB1 RB2 RB3 RB4 RB5   RF0 RF1 RF2 RF3 RF4 RF5
#define KEYS_THUMBS LH3 LH2 LH1 LH0 LEC   REC RH0 RH1 RH2 RH3
