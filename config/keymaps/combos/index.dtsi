#include "zmk-helpers/key-labels/lily58.h"

#include "../behaviours/macros/index.dtsi"

/ {
    combos {
        compatible = "zmk,combos";

        combo_switch_lang_on_os_rpd {
            timeout-ms = <100>;
            require-prior-idle-ms = <DEFAULT_PRIOR_IDLE>;
            layers = <QWERTY QWERTYWithRpdLower>;
            key-positions = <RM4 LB4 RB3>;
            bindings = <&macro_lang_switch_on_os_rpd>;
        };
    };
};
