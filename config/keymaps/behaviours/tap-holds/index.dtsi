#include "../../constants.dtsi"

/ {
  behaviors {
    thumb_layer_tap: thumb_layer_tap {
      compatible = "zmk,behavior-hold-tap";
      #binding-cells = <2>;
      bindings = <&mo>, <&kp>;

      flavor = "balanced";
      tapping-term-ms = <DEFAULT_TAPPING_TERM>;
      quick-tap-ms = <DEFAULT_QUICK_TAP>;
      require-prior-idle-ms = <DEFAULT_PRIOR_IDLE>;
    };

    thumb_layer_tog: thumb_layer_tog {
      compatible = "zmk,behavior-hold-tap";
      #binding-cells = <2>;
      bindings = <&mo>, <&tog>;

      flavor = "balanced";
      tapping-term-ms = <DEFAULT_TAPPING_TERM>;
      quick-tap-ms = <DEFAULT_QUICK_TAP>;
      require-prior-idle-ms = <DEFAULT_PRIOR_IDLE>;
    };
  };
};
