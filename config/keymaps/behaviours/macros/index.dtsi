/ {
    macros {
        macro_lang_switch_on_os_rpd: language_switch_on_os_rpd {
            compatible = "zmk,behavior-macro";
            #binding-cells = <0>;
            wait-ms = <10>;
            bindings
                = <&macro_press &kp RSHFT &kp RALT>
                , <&macro_release &kp RSHFT &kp RALT>
                , <&macro_tap &tog QWERTYWithRpdLower>
                ;
        };
    };
};
